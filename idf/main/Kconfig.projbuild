## idf/main/Kconfig.projbuild
```kconfig
menu "短信转发器配置"

    config WIFI_SSID
        string "WiFi SSID"
        default ""
        help
            设备启动时连接的 2.4G 路由器 SSID（不支持 5G）。

            注意：为了不把家里的 WiFi 密码提交到仓库，这里的默认值是空的。
            实际使用的值保存在 sdkconfig 中（已被 .gitignore 忽略），
            请用 idf.py menuconfig 填写，或在 sdkconfig 里直接设置
            CONFIG_WIFI_SSID / CONFIG_WIFI_PASSWORD。

    config WIFI_PASSWORD
        string "WiFi 密码"
        default ""
        help
            设备启动时连接的路由器密码。留空表示开放网络。

    config MDNS_NAME
        string "mDNS 设备名（留空则按 MAC 自动生成）"
        default ""
        help
            留空时设备名形如 sms-9e3c（MAC 后两字节），同一内网多台设备不会冲突，
            访问地址：http://sms-9e3c.local/
            如果填了固定名称，请给每台设备用不同的名字，否则 mDNS 会冲突。

    config HEARTBEAT_HOST
        string "网络自检目标主机"
        default "www.baidu.com"
        help
            心跳任务用“域名解析 + TCP 连接”判断网络是否可用，默认访问百度的 80 端口。
            如果所在网络访问不了该域名，可改成网关域名或其他可达主机。

    config HEARTBEAT_PORT
        int "网络自检目标端口"
        default 80
        range 1 65535

    config HEARTBEAT_INTERVAL_S
        int "网络自检间隔（秒）"
        default 60
        range 10 600
        help
            连续 3 次失败会主动重连 WiFi，连续 6 次失败会重启设备。

    config OTA_MANIFEST_URL
        string "固件版本清单地址"
        default "https://github.com/chenxuuu/sms_forwarding/releases/latest/download/latest.json"
        help
            设备每天 GET 这个地址检查新版本，只读取几百字节 JSON，不会下载固件。

            国内访问 GitHub 不稳定时，把它换成自己的镜像地址即可，例如
            https://your-domain/sms/latest.json，JSON 格式见 docs/ota-plan.md。

endmenu
```
